## kernel-headers/drivers/arm/mm_monitor/Kconfig
```kconfig
# SPDX-License-Identifier: GPL-2.0-only
#
# arm spe dirver
#
config ARM_SPE_MEM_SAMPLING
	bool "In-kernel SPE for driver for page access profiling"
	depends on ARM_SPE_PMU
	default n
	help
	  Enable support for the ARMv8.2 Statistical Profiling Extension (SPE),
	  which provides periodic sampling of memory accesses and operations
	  in the CPU pipeline. This extension allows the driver to monitor
	  memory access patterns, which can help with performance tuning,
	  debugging, and analyzing memory-related bottlenecks.

	  This feature is only available on ARM64 architecture and will fall
	  back to the native software sampling mechanism if the ARM SPE PMU
	  (Performance Monitoring Unit) is in use. When enabled, this
	  configuration will activate the in-kernel driver to collect profiling
	  data on page-level memory accesses.
```

## kernel-headers/drivers/crypto/sedriver/Kconfig
```kconfig
#
# se chip configuration
#
config SW_SE_CHIP
	tristate "wst se chip driver"
	depends on LOONGARCH
	help
	  If you have a wst security chip,
	  say Yes and it will be accessible from within Linux.
	  To compile this driver as a module, choose M here;
	  the module will be called tpm_tis_i2c.  If unsure, say N.
```

## kernel-headers/drivers/net/ethernet/huawei/hibifur/Kconfig
```kconfig
# SPDX-License-Identifier: GPL-2.0-only
#
# Huawei driver configuration
#

config HIBIFUR
	tristate "Huawei Intelligent Network Interface Card Bifur Driver"
	depends on HINIC3 && PCI_MSI && NUMA && PCI_IOV && DCB && (X86 || ARM64)
	help
	  This driver supports HIBIFUR PCIE Ethernet cards.
	  To compile this driver as part of the kernel, choose Y here.
	  If unsure, choose N.
	  The default is N.
```

## kernel-headers/drivers/net/ethernet/motorcomm/Kconfig
```kconfig
# SPDX-License-Identifier: GPL-2.0-only
#
# Motorcomm network device configuration
#

config NET_VENDOR_MOTORCOMM
	bool "Motorcomm devices"
	default y
	help
	  If you have a network (Ethernet) device belonging to this class,
	  say Y.

	  Note that the answer to this question doesn't directly affect the
	  kernel: saying N will just cause the configurator to skip all
	  the questions about Motorcomm devices. If you say Y, you will be
	  asked for your specific device in the following questions.

if NET_VENDOR_MOTORCOMM

config YT6801
	tristate "Motorcomm(R) 6801 PCI-Express Gigabit Ethernet support"
	depends on PCI && NET
	select MOTORCOMM_PHY
	help
	  This driver supports Motorcomm(R) 6801 gigabit ethernet family of
	  adapters.

endif # NET_VENDOR_MOTORCOMM
```

## kernel-headers/drivers/scsi/leapioraid/Kconfig
```kconfig
#
# Kernel configuration file for the LEAPIORAID
#

config SCSI_LEAPIORAID
	tristate "LeapIO RAID Adapter"
	depends on PCI && SCSI
	select SCSI_SAS_ATTRS
	select RAID_ATTRS
	select IRQ_POLL
	help
	This driver supports LEAPIO RAID controller, which supports PCI Express Gen4 interface
	and supports SAS/SATA HDD/SSD.
```

## kernel-headers/kernel/bpf-rvi/Kconfig
```kconfig
# SPDX-License-Identifier: GPL-2.0-only
# Copyright (c) 2025 Huawei Technologies Co., Ltd

config BPF_RVI
	bool "Resource View Isolation with BPF"
	depends on BPF_EVENTS
	depends on BPF_SYSCALL
	depends on BPF_JIT
	depends on CPUSETS
	default n
	help
	  A resource view is a bundle of interfaces under /proc and /sys
	  providing system resource information, e.g. /proc/{cpu,mem}info. This
	  feature implements a container-sensitive resource view, whose output
	  can be customized based on the container's configuration and its
	  limitation on many kinds of system resources. This feature aims to
	  be a substitute for LXCFS with better performance and scalability.

	  If you are unsure how to answer this question, answer N.
```

## kernel-headers/lib/Kconfig.kabi
```kconfig
# SPDX-License-Identifier: GPL-2.0-only
config KABI_COMPAT
	bool "Enable kabi compatible fix"
	depends on X86_64 || ARM64
	default n
	help
          Support KABI compatibility fix. Some distributions need to maintain
          and fix KABI compatibility so that drivers do not need to be recompiled
          during kernel upgrades. Fixing KABI compatibility is a dangerous and
          hacking job. Developers need to know clearly what they are doing and
          the risks they may face. Related KABI fix actions are closely related
          to the processor architecture. Fixes may not be appropriate for all
          architectures. Improper use may cause system panic.

	  If unsure, say N.

config KABI_RESERVE
	bool "Enable KABI PADDING RESERVE"
	default y
	depends on KABI_COMPAT
	help
	  This option enables KABI padding reserve.
	  For some embedded system, KABI padding reserve may be not necessary.
	  Disable it on demand.

config KABI_SIZE_ALIGN_CHECKS
	bool "Enable more stringent kabi checks in the macros"
	default y
	depends on KABI_RESERVE
	help
	  This option enables more stringent kabi checks. Those must be disable
	  in case of a debug-build because they allow to change struct sizes.
```
